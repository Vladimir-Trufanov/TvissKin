/* ========================================================================= */
/*   MP34DT06JTR.ino                                                         */
/*   (c) 2024-01-14 [2024-01-14] Труфанов Владимир                           */
/*                                                                           */
/*   Description:   скетч проверки цифрового микрофона, построенного на базе */
/*                  MP34DT06JTR. Для работы используется библиотека PDM. Эта */
/*     библиотека устанавливается вместе с платой Arduino Nano 33 BLE Sense. */
/*                         Документ библиотеки PDM можно прочитать по адресу */
/*                                  https://www.arduino.cc/en/Reference/PDM. */
/*          В скетче выводится график значений амплитуды цифрового микрофона */
/*                                     с помощью последовательного плоттера. */
/* ========================================================================= */

// Подключаем библиотеку PDM. Затем объявляем переменную sampleBuffer 
// и функцию samplesRead.

#include <PDM.h>
short sampleBuffer[256];
volatile int samplesRead; // количество считанных примеров

// Инициализируем последовательную связь.
// Передаем функцию onPDMdata() в PDM.onReceive() и вызываем PDM.begin() 
// для инициализации библиотеки PDM
void setup() 
{
   Serial.begin(9600);
   while (!Serial);
   // Настраиваем обратный вызов приема данных
   PDM.onReceive(onPDMdata);
   // Запускаем один канал (моно режим) с частотой дискретизации 16 кГц
   if (!PDM.begin(1, 16000)) 
   {
      Serial.println("Failed to start PDM!");
      while (1);
   }
}

// Проверяем значение samplesRead. Если значение samplesRead больше 1, то
// читаем данные датчика из sampleBuffer []. Затем распечатываем данные на 
// последовательном терминале (плоттере).
void loop() 
{
   if (samplesRead) 
   {
      for (int i = 0; i < samplesRead; i++) 
      {
         Serial.println(sampleBuffer[i]);
      }
      // Очищаем счетчик чтения
      samplesRead = 0;
   }
}

// Cчитываем данные с цифрового микрофона. Вначале проверяем, доступны ли 
// данные, с помощью функции PDM.available(). Затем читаем данные датчика, 
// вызвав функцию PDM.read(). Эта функция используется путем передачи ее 
// в функцию PDM.onReceive() в функции setup().
void onPDMdata() 
{
  // Запрашиваем количество доступных байтов
  int bytesAvailable = PDM.available();
  // Считываем в буфер 
  PDM.read(sampleBuffer, bytesAvailable);
  // 16 бит, 2 байта на выборку
  samplesRead = bytesAvailable / 2;
}

/* ========================================================= MP34DT06JTR.ino */
